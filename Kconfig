## subsys/Kconfig
```kconfig
#
# Copyright (c) 2023 Nordic Semiconductor
#
# SPDX-License-Identifier: LicenseRef-Nordic-5-Clause
#

if CHIP

config MATTER_APP_TASK_QUEUE_SIZE
	int "Maximum number of tasks delegated to be run in the application queue"
	default 10
	help
	  Define the maximum size of the queue dedicated for application tasks that
	  have to be run in the application thread context.

config MATTER_APP_TASK_MAX_SIZE
	int "Maximum size of application task in bytes"
	default 16
	help
	  Defines the maximum size of a functor that can be put in the application
	  thread's task queue.

config MATTER_CUSTOM_BLUETOOTH_ADVERTISING
	bool "Define the custom behavior of the Bluetooth advertisement in the application code"
	help
	  Disable the default Bluetooth advertising start which is defined in the board.cpp file and
	  allows to use the custom one.

config MATTER_OPERATIONAL_KEYS_MIGRATION_TO_ITS
	bool "Operational keys migration feature"
	depends on CHIP_CRYPTO_PSA
	help
	  Enables migration of the operational keys stored in the persistent storage to the PSA ITS secure storage.
	  Enable this feature while updating the firmware of in-field devices that run Mbed TLS cryptography backend
	  to the firmware based on PSA Crypto API.

config MATTER_FACTORY_RESET_ON_KEY_MIGRATION_FAILURE
	bool "Perform factory reset if the operational key migration failed"
	default y
	depends on MATTER_OPERATIONAL_KEYS_MIGRATION_TO_ITS
	help
	  Allow device to perform factory reset if the operational key for Fabric has not been migrated
	  properly to PSA ITS storage.

config MATTER_LEDS
	bool "LEDs usage"
	default y
	depends on DK_LIBRARY
	help
	  Enables LEDs module to be used in the application.

config MATTER_SETTINGS_SHELL
	bool "Settings shell for Matter purposes"
	default y if CHIP_MEMORY_PROFILING
	depends on SHELL
	depends on NVS || ZMS
	help
	  Allows using matter_settings shell commands.
	  You can use the following commands:
	  peak - to read the maximum settings usage.
	  reset - to reset peak value.
	  get_size - to read the size of specific value.
	  current - to read current settings usage.
	  free - to read free settings space.

config MATTER_TEST_EVENT_TRIGGERS
	bool "Test event triggers support"
	default y
	help
	  Enables support for test event triggers for the specific use-cases.

config MATTER_TEST_EVENT_TRIGGERS_MAX
	int "Maximum amount of event triggers"
	default 8
	depends on MATTER_TEST_EVENT_TRIGGERS
	help
	  Defines the maximum amount of event triggers.

config MATTER_TEST_EVENT_TRIGGERS_REGISTER_DEFAULTS
	bool "Register default triggers for Matter sample"
	depends on MATTER_TEST_EVENT_TRIGGERS
	default y
	help
	  Automatically register default triggers such as factory reset,
	  device reboot, OTA start query.

config MATTER_TEST_EVENT_TRIGGERS_MAX_TRIGGERS_DELEGATES
	int "Maximum amount of the trigger delegates"
	default 3
	depends on MATTER_TEST_EVENT_TRIGGERS
	help
	  Defines the maximum number for the TestEventTriggerDelegate implementations
	  to be registered in the nRF test event triggers class.

config MATTER_TEST_SHELL
	bool "Test - specific shell commands support for Matter samples"
	depends on CHIP_LIB_SHELL
	help
	  Enables support for test - specific shell commands in Matter samples.

config MATTER_PERSISTENT_STORAGE
	bool "Persistent storage support for Matter samples"
	help
	  Matter persistent storage support with the configurable backend.

config MATTER_ZAP_FILE_PATH
	string "Path in sample, under which ZAP file is located"
	help
	  Absolute path to location under which ZAP file is located.
	  It shall contain the file name and .zap extension.

# PlatformManagerImpl.cpp skips add_entropy_source() when this is set.
# PSA add_entropy_source() returns UNSUPPORTED; native_sim has no CONFIG_NRF_SECURITY.
config MBEDTLS_ENTROPY_POLL_ZEPHYR
	bool
	default y if ARCH_POSIX && CHIP_CRYPTO_PSA

# PSAOperationalKeystore needs persistent PSA key slots (ITS/secure storage).
# native_sim has neither — use PersistentStorageOperationalKeystore (ZMS) instead.
config MATTER_PERSISTENT_STORAGE_OPERATIONAL_KEYS
	bool
	default y if ARCH_POSIX && CHIP_CRYPTO_PSA
	depends on CHIP_CRYPTO_PSA
	help
	  On ARCH_POSIX (native_sim), store operational fabric keys in the settings
	  backend instead of PSA persistent key lifetime. Avoids PSA_ERROR_NOT_SUPPORTED
	  during CommissioningComplete (SendComplete).

config MATTER_CERTIFICATION
	bool "Patches for Matter platform certification"
	help
	  It enables including software patches required for the Matter platform certification
	  purposes. Currently it works only with the Matter template sample.

config DISABLE_THREAD_DIAGNOSTIC_RLOC16
	bool "Exclude Rloc16 from Thread Network Diagnostics attribute list"
	default y
	help
	  When enabled, the Thread Network Diagnostics cluster replaces the default Matter SDK
	  implementation and omits the Rloc16 attribute from the published attribute list.

config DISABLE_THREAD_DIAGNOSTIC_EXTADDR
	bool "Exclude ExtAddress from Thread Network Diagnostics attribute list"
	default y
	help
	  When enabled, the Thread Network Diagnostics cluster replaces the default Matter SDK
	  implementation and omits the ExtAddress attribute from the published attribute list.

config MATTER_USE_DEFAULT_BUTTON_HANDLER
	bool "Use default button handler alongside the application one"
	default y
	help
	  When enabled, the button handler responsible for factory reset and DFU is used alongside
	  application handler. In order to override this handler, disable this config.

choice MATTER_ZAP_GENERATION_MODE
	prompt "Matter ZAP generation mode"
	default MATTER_ZAP_GENERATION_STATIC

config MATTER_ZAP_GENERATION_BUILD_TIME
	bool "Generate ZAP artifacts at build time"

config MATTER_ZAP_GENERATION_STATIC
	bool "Use pre-generated ZAP artifacts"
endchoice

rsource "persistent_storage/Kconfig"
rsource "watchdog/Kconfig"
rsource "diagnostic/Kconfig"

endif # CHIP
```

## subsys/nfc_commissioning/Kconfig
```kconfig
# Copyright (c) 2026 Nordic Semiconductor ASA
# SPDX-License-Identifier: Apache-2.0

if CHIP_NFC_COMMISSIONING_MODE_UNPOWERED

choice MATTER_NFC_COMMISSIONING_BACKEND
	prompt "NFC commissioning tag backend"
	default MATTER_NFC_COMMISSIONING_BACKEND_ST25DAC

config MATTER_NFC_COMMISSIONING_BACKEND_ST25DAC
	bool "ST25DA-C NFC tag"
	depends on ST25DAC
	help
	  Select ST Microelectronics ST25DA-C NFC tag support.

endchoice

config MATTER_NFC_COMMISSIONING_SHELL
	bool "NFC commissioning Zephyr shell command (nfc)"
	depends on SHELL
	help
	  Register the top-level Zephyr shell command "nfc". Backend-specific
	  subcommands are supplied by the selected tag driver.

config MATTER_NFC_COMMISSIONING_BUTTON_TRIGGER
	bool "Trigger NFC commissioning with button"
	default y
	depends on DK_LIBRARY
	help
	  When enabled, pressing a specific button on a Nordic DK powers the ST25DA-C
	  (VCC) and starts I2C commissioning, same as the deferred boot path.

if MATTER_NFC_COMMISSIONING_SHELL

config SHELL_STACK_SIZE
	default 4096

endif # MATTER_NFC_COMMISSIONING_SHELL

endif # CHIP_NFC_COMMISSIONING_MODE_UNPOWERED
```

## sysbuild/Kconfig.matter
```kconfig
# Copyright (c) 2024 Nordic Semiconductor
#
# SPDX-License-Identifier: LicenseRef-Nordic-5-Clause

menuconfig MATTER_ADD_ON
	bool "Matter"
	depends on ZEPHYR_CONNECTEDHOMEIP_MODULE

if MATTER_ADD_ON

config MATTER_ADD_ON_FACTORY_DATA_GENERATE
	bool "Create Matter factory data"
	help
	  Generate Matter factory data set and the HEX file for the sample during the building
	  process.

config MATTER_ADD_ON_FACTORY_DATA_MERGE_WITH_FIRMWARE
	bool "Merge generated factory data with merged.hex output"
	depends on MATTER_ADD_ON_FACTORY_DATA_GENERATE
	default y
	help
	  Enables merging the generated factory data with the merged.hex output build file. As a
	  result, the merged.hex build output file, which is used when flashing the firmware using
	  the west tool, includes the factory data as well.

config MATTER_ADD_ON_OTA
	bool "Matter Add-On OTA Software Update"
	default y
	help
	  Enables over-the-air (OTA) Requestor role that allows the node to perform Device Firmware
	  Update by querying and downloading a new firmware image from a peer OTA Provider node.

config MATTER_ADD_ON_OTA_IMAGE_FILE_NAME
	string "OTA image file name"
	default "matter.ota"
	depends on MATTER_ADD_ON_OTA
	help
	  Provides the file name of the generated Matter OTA image in the build directory.

endif # MATTER_ADD_ON

config MATTER_ROOT_PATH
	string "Path to the Matter root directory"
	default "${ZEPHYR_BASE}/../modules/lib/matter"
	help
	  Path to the Matter root folder to which all scripts and CMake configuration
	  will point within the ncs-matter repository.
	  Change this value to your Matter root directory if the path is different than
	  the default one: $ZEPHYR_BASE/../modules/lib/matter.
```

## west.yml
```yaml
# Copyright (c) 2026 Nordic Semiconductor ASA
# SPDX-License-Identifier: Apache-2.0

manifest:
  remotes:
    - name: ncs
      url-base: https://github.com/nrfconnect

  projects:
    - name: nrf
      remote: ncs
      repo-path: sdk-nrf
      revision: 2f093e5a95eb124dd3fd02676359f8c75c531c32
      import: true
    - name: matter
      remote: ncs
      path: modules/lib/matter
      repo-path: sdk-connectedhomeip
      revision: 65d3380f26d5d4848179b7af5caf64e3514104c9
      submodules:
        - name: nlio
          path: third_party/nlio/repo
        - name: nlassert
          path: third_party/nlassert/repo
        - name: pigweed
          path: third_party/pigweed/repo
        - name: jsoncpp
          path: third_party/jsoncpp/repo
        - name: uriparser
          path: third_party/uriparser/repo
      userdata:
        ncs:
          upstream-url: https://github.com/project-chip/connectedhomeip
          upstream-sha: badaac1eae0df6902c1d009981c0e0d18845aeea
          compare-by-default: false

  self:
    path: ncs-matter
    west-commands: scripts/west/west-commands.yml
```
