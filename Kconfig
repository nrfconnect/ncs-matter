## Kconfig
```kconfig
#
# Copyright (c) 2026 Nordic Semiconductor
#
# SPDX-License-Identifier: LicenseRef-Nordic-5-Clause
#

rsource "subsys/Kconfig"

config MATTER_ROOT_PATH
    string "Do not modify it"
    help
      This value is a placeholder. The actual value is set by sysbuild
      Kconfig with the same name.
```

## boards/shields/st25dac/Kconfig.shield
```kconfig
# Copyright (c) 2026 Nordic Semiconductor ASA
# SPDX-License-Identifier: Apache-2.0

config SHIELD_ST_25_DAC
	def_bool $(shields_list_contains,st_25_dac)
```

## drivers/st25dac/Kconfig
```kconfig
# Copyright (c) 2026 Nordic Semiconductor ASA
# SPDX-License-Identifier: Apache-2.0

menuconfig ST25DAC
	bool "ST25DA-C NFC tag driver"
	default y
	depends on SHIELD_ST_25_DAC
	select I2C
	select GPIO
	select PSA_WANT_KEY_TYPE_AES
	select PSA_WANT_ALG_CMAC
	select PSA_WANT_ALG_ECB_NO_PADDING
	select ENTROPY_GENERATOR
	help
	  Enable the STMicroelectronics ST25DA-C transport stack for
	  unpowered Matter NFC commissioning. Requires an st,st25dac
	  devicetree node with ctrl-gpios and vcc-gpios.

if ST25DAC

config ST25DAC_BUILD_FROM_SOURCE
	bool "Build ST25DA-C stack from sources"
	help
	  Compile the ST25DA-C stack from sources.

config ST25DAC_LIB_STRIP_DEBUG
	bool "Strip debug info from exported libst25dac.a"
	depends on ST25DAC_BUILD_FROM_SOURCE
	help
	  When building from source, run strip --strip-debug on the exported
	  libst25dac.a artifact.

config ST25DAC_FW_UPDATE
	bool "Allow performing ST25DA-C firmware update"
	help
	  Include functionality that allows performing firmware update of
	  the ST25DA-C module.

module = ST25DAC
module-str = ST25DA-C
source "$(ZEPHYR_BASE)/subsys/logging/Kconfig.template.log_config"

endif # ST25DAC
```

## dts/bindings/nfc/st,st25dac.yaml
```yaml
# Copyright (c) 2026 Nordic Semiconductor ASA
# SPDX-License-Identifier: Apache-2.0

description: |
  STMicroelectronics ST25DA-C dynamic NFC tag used for Matter NFC commissioning.
  Communicates over I2C. The 7-bit address is the node's reg property.

compatible: "st,st25dac"

include: i2c-device.yaml

properties:
  ctrl-gpios:
    type: phandle-array
    required: true
    description: |
      Bidirectional CTRL line (CN11.3). Configured as input with rising-edge
      interrupt when listening for tag I2C-mode events; temporarily reconfigured
      as open-drain output to pulse the tag into I2C mode.

  vcc-gpios:
    type: phandle-array
    required: true
    description: Tag supply enable (CN11.1). Active high powers the ST25DA-C.
```

## samples/bridge/sample.yaml
```yaml
sample:
  description: Matter Bridge
  name: Matter Bridge application
common:
  tags:
    - sysbuild
    - ci_applications_matter
tests:
  applications.matter_bridge.release:
    sysbuild: true
    build_only: true
    extra_args:
      - FILE_SUFFIX=release
      - CONFIG_BRIDGE_GENERIC_SWITCH_BRIDGED_DEVICE=n
      - CONFIG_BRIDGE_ONOFF_LIGHT_SWITCH_BRIDGED_DEVICE=y
    integration_platforms:
      - nrf5340dk/nrf5340/cpuapp
      - nrf54lm20dk/nrf54lm20b/cpuapp
      - nrf54lm20dk/nrf54lm20a/cpuapp
    platform_allow:
      - nrf5340dk/nrf5340/cpuapp
      - nrf54lm20dk/nrf54lm20b/cpuapp
      - nrf54lm20dk/nrf54lm20a/cpuapp
  applications.matter_bridge.nrf7002eb2.release:
    sysbuild: true
    build_only: true
    extra_args:
      - FILE_SUFFIX=release
      - CONFIG_BRIDGE_GENERIC_SWITCH_BRIDGED_DEVICE=n
      - CONFIG_BRIDGE_ONOFF_LIGHT_SWITCH_BRIDGED_DEVICE=y
      - bridge_SHIELD=nrf7002eb2
      - SB_CONFIG_WIFI_NRF70=y
    integration_platforms:
      - nrf54lm20dk/nrf54lm20b/cpuapp
      - nrf54lm20dk/nrf54lm20a/cpuapp
    platform_allow:
      - nrf54lm20dk/nrf54lm20b/cpuapp
      - nrf54lm20dk/nrf54lm20a/cpuapp
  applications.matter_bridge.nrf7120.release:
    sysbuild: true
    build_only: true
    extra_args:
      - FILE_SUFFIX=release
      - CONFIG_BRIDGE_GENERIC_SWITCH_BRIDGED_DEVICE=n
      - CONFIG_BRIDGE_ONOFF_LIGHT_SWITCH_BRIDGED_DEVICE=y
      - CONFIG_CHIP_WIFI=y
      - CONFIG_WIFI_NRF71_PATCH=y
      - EXTRA_DTC_OVERLAY_FILE=${ZEPHYR_NRFXLIB_MODULE_DIR}/nrf71_wifi/bins/0.1.0/nrf7120_wifi_patch.dtsi
    integration_platforms:
      - nrf7120dk/nrf7120/cpuapp
    platform_allow:
      - nrf7120dk/nrf7120/cpuapp
  applications.matter_bridge.debug:
    sysbuild: true
    build_only: true
    extra_args:
      - CONFIG_BRIDGE_GENERIC_SWITCH_BRIDGED_DEVICE=n
      - CONFIG_BRIDGE_ONOFF_LIGHT_SWITCH_BRIDGED_DEVICE=y
    integration_platforms:
      - nrf5340dk/nrf5340/cpuapp
      - nrf54lm20dk/nrf54lm20b/cpuapp
      - nrf54lm20dk/nrf54lm20a/cpuapp
    platform_allow:
      - nrf5340dk/nrf5340/cpuapp
      - nrf54lm20dk/nrf54lm20b/cpuapp
      - nrf54lm20dk/nrf54lm20a/cpuapp
  applications.matter_bridge.nrf7002eb2.debug:
    sysbuild: true
    build_only: true
    extra_args:
      - CONFIG_BRIDGE_GENERIC_SWITCH_BRIDGED_DEVICE=n
      - CONFIG_BRIDGE_ONOFF_LIGHT_SWITCH_BRIDGED_DEVICE=y
      - bridge_SHIELD=nrf7002eb2
      - SB_CONFIG_WIFI_NRF70=y
    integration_platforms:
      - nrf54lm20dk/nrf54lm20b/cpuapp
      - nrf54lm20dk/nrf54lm20a/cpuapp
    platform_allow:
      - nrf54lm20dk/nrf54lm20b/cpuapp
      - nrf54lm20dk/nrf54lm20a/cpuapp
  applications.matter_bridge.nrf7120.debug:
    sysbuild: true
    build_only: true
    extra_args:
      - CONFIG_BRIDGE_GENERIC_SWITCH_BRIDGED_DEVICE=n
      - CONFIG_BRIDGE_ONOFF_LIGHT_SWITCH_BRIDGED_DEVICE=y
      - CONFIG_CHIP_WIFI=y
      - CONFIG_WIFI_NRF71_PATCH=y
      - EXTRA_DTC_OVERLAY_FILE=${ZEPHYR_NRFXLIB_MODULE_DIR}/nrf71_wifi/bins/0.1.0/nrf7120_wifi_patch.dtsi
    integration_platforms:
      - nrf7120dk/nrf7120/cpuapp
    platform_allow:
      - nrf7120dk/nrf7120/cpuapp
  applications.matter_bridge.br_ble:
    sysbuild: true
    build_only: true
    extra_args:
      - CONFIG_BRIDGED_DEVICE_BT=y
      - CONFIG_BRIDGE_GENERIC_SWITCH_BRIDGED_DEVICE=n
      - CONFIG_BRIDGE_ONOFF_LIGHT_SWITCH_BRIDGED_DEVICE=y
    integration_platforms:
      - nrf5340dk/nrf5340/cpuapp
      - nrf54lm20dk/nrf54lm20b/cpuapp
      - nrf54lm20dk/nrf54lm20a/cpuapp
    platform_allow:
      - nrf5340dk/nrf5340/cpuapp
      - nrf54lm20dk/nrf54lm20b/cpuapp
      - nrf54lm20dk/nrf54lm20a/cpuapp
  applications.matter_bridge.nrf7002eb2.br_ble:
    sysbuild: true
    build_only: true
    extra_args:
      - CONFIG_BRIDGED_DEVICE_BT=y
      - CONFIG_BRIDGE_GENERIC_SWITCH_BRIDGED_DEVICE=n
      - CONFIG_BRIDGE_ONOFF_LIGHT_SWITCH_BRIDGED_DEVICE=y
      - bridge_SHIELD=nrf7002eb2
      - SB_CONFIG_WIFI_NRF70=y
    integration_platforms:
      - nrf54lm20dk/nrf54lm20b/cpuapp
      - nrf54lm20dk/nrf54lm20a/cpuapp
    platform_allow:
      - nrf54lm20dk/nrf54lm20b/cpuapp
      - nrf54lm20dk/nrf54lm20a/cpuapp
  applications.matter_bridge.nrf7120.br_ble:
    sysbuild: true
    build_only: true
    extra_args:
      - CONFIG_BRIDGED_DEVICE_BT=y
      - CONFIG_BRIDGE_GENERIC_SWITCH_BRIDGED_DEVICE=n
      - CONFIG_BRIDGE_ONOFF_LIGHT_SWITCH_BRIDGED_DEVICE=y
      - CONFIG_CHIP_WIFI=y
      - CONFIG_WIFI_NRF71_PATCH=y
      - EXTRA_DTC_OVERLAY_FILE=${ZEPHYR_NRFXLIB_MODULE_DIR}/nrf71_wifi/bins/0.1.0/nrf7120_wifi_patch.dtsi
    integration_platforms:
      - nrf7120dk/nrf7120/cpuapp
    platform_allow:
      - nrf7120dk/nrf7120/cpuapp
  applications.matter_bridge.release.br_ble:
    sysbuild: true
    build_only: true
    extra_args:
      - FILE_SUFFIX=release
      - CONFIG_BRIDGED_DEVICE_BT=y
      - CONFIG_BRIDGE_GENERIC_SWITCH_BRIDGED_DEVICE=n
      - CONFIG_BRIDGE_ONOFF_LIGHT_SWITCH_BRIDGED_DEVICE=y
    integration_platforms:
      - nrf5340dk/nrf5340/cpuapp
      - nrf54lm20dk/nrf54lm20b/cpuapp
      - nrf54lm20dk/nrf54lm20a/cpuapp
    platform_allow:
      - nrf5340dk/nrf5340/cpuapp
      - nrf54lm20dk/nrf54lm20b/cpuapp
      - nrf54lm20dk/nrf54lm20a/cpuapp
  applications.matter_bridge.nrf7002eb2.release.br_ble:
    sysbuild: true
    build_only: true
    extra_args:
      - FILE_SUFFIX=release
      - CONFIG_BRIDGED_DEVICE_BT=y
      - CONFIG_BRIDGE_GENERIC_SWITCH_BRIDGED_DEVICE=n
      - CONFIG_BRIDGE_ONOFF_LIGHT_SWITCH_BRIDGED_DEVICE=y
      - bridge_SHIELD=nrf7002eb2
      - SB_CONFIG_WIFI_NRF70=y
    integration_platforms:
      - nrf54lm20dk/nrf54lm20b/cpuapp
      - nrf54lm20dk/nrf54lm20a/cpuapp
    platform_allow:
      - nrf54lm20dk/nrf54lm20b/cpuapp
      - nrf54lm20dk/nrf54lm20a/cpuapp
  applications.matter_bridge.nrf7120.release.br_ble:
    sysbuild: true
    build_only: true
    extra_args:
      - FILE_SUFFIX=release
      - CONFIG_BRIDGED_DEVICE_BT=y
      - CONFIG_BRIDGE_GENERIC_SWITCH_BRIDGED_DEVICE=n
      - CONFIG_BRIDGE_ONOFF_LIGHT_SWITCH_BRIDGED_DEVICE=y
      - CONFIG_CHIP_WIFI=y
      - CONFIG_WIFI_NRF71_PATCH=y
      - EXTRA_DTC_OVERLAY_FILE=${ZEPHYR_NRFXLIB_MODULE_DIR}/nrf71_wifi/bins/0.1.0/nrf7120_wifi_patch.dtsi
    integration_platforms:
      - nrf7120dk/nrf7120/cpuapp
    platform_allow:
      - nrf7120dk/nrf7120/cpuapp
  applications.matter_bridge.br_ble.smp_dfu:
    sysbuild: true
    build_only: true
    extra_args:
      - CONFIG_CHIP_DFU_OVER_BT_SMP=y
      - CONFIG_BRIDGED_DEVICE_BT=y
      - CONFIG_BRIDGE_GENERIC_SWITCH_BRIDGED_DEVICE=n
      - CONFIG_BRIDGE_ONOFF_LIGHT_SWITCH_BRIDGED_DEVICE=y
    integration_platforms:
      - nrf54lm20dk/nrf54lm20b/cpuapp
      - nrf54lm20dk/nrf54lm20a/cpuapp
    platform_allow:
      - nrf54lm20dk/nrf54lm20b/cpuapp
      - nrf54lm20dk/nrf54lm20a/cpuapp
  applications.matter_bridge.nrf7002eb2.br_ble.smp_dfu:
    sysbuild: true
    build_only: true
    extra_args:
      - CONFIG_CHIP_DFU_OVER_BT_SMP=y
      - CONFIG_BRIDGED_DEVICE_BT=y
      - CONFIG_BRIDGE_GENERIC_SWITCH_BRIDGED_DEVICE=n
      - CONFIG_BRIDGE_ONOFF_LIGHT_SWITCH_BRIDGED_DEVICE=y
      - bridge_SHIELD=nrf7002eb2
      - SB_CONFIG_WIFI_NRF70=y
    integration_platforms:
      - nrf54lm20dk/nrf54lm20b/cpuapp
      - nrf54lm20dk/nrf54lm20a/cpuapp
    platform_allow:
      - nrf54lm20dk/nrf54lm20b/cpuapp
      - nrf54lm20dk/nrf54lm20a/cpuapp
  applications.matter_bridge.br_ble.memory_profiling:
    sysbuild: true
    build_only: true
    extra_args:
      - CONFIG_BRIDGE_GENERIC_SWITCH_BRIDGED_DEVICE=n
      - CONFIG_BRIDGE_ONOFF_LIGHT_SWITCH_BRIDGED_DEVICE=y
      - CONFIG_CHIP_MEMORY_PROFILING=y
      - CONFIG_BRIDGED_DEVICE_BT=y
      - CONFIG_BRIDGE_MIGRATE_VERSION_1=n
    integration_platforms:
      - nrf5340dk/nrf5340/cpuapp
      - nrf54lm20dk/nrf54lm20b/cpuapp
      - nrf54lm20dk/nrf54lm20a/cpuapp
    platform_allow:
      - nrf5340dk/nrf5340/cpuapp
      - nrf54lm20dk/nrf54lm20b/cpuapp
      - nrf54lm20dk/nrf54lm20a/cpuapp
  applications.matter_bridge.memory_profiling:
    sysbuild: true
    build_only: true
    extra_args:
      - CONFIG_BRIDGE_GENERIC_SWITCH_BRIDGED_DEVICE=n
      - CONFIG_BRIDGE_ONOFF_LIGHT_SWITCH_BRIDGED_DEVICE=y
      - CONFIG_CHIP_MEMORY_PROFILING=y
    integration_platforms:
      - nrf54lm20dk/nrf54lm20b/cpuapp
      - nrf54lm20dk/nrf54lm20a/cpuapp
    platform_allow:
      - nrf54lm20dk/nrf54lm20b/cpuapp
      - nrf54lm20dk/nrf54lm20a/cpuapp
  applications.matter_bridge.smart_plug:
    sysbuild: true
    build_only: true
    extra_args:
      - EXTRA_CONF_FILE=onoff_plug.conf
    integration_platforms:
      - nrf5340dk/nrf5340/cpuapp
    platform_allow: nrf5340dk/nrf5340/cpuapp
```
