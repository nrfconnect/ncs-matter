## CMakeLists.txt
```
#
# Copyright (c) 2021 Nordic Semiconductor ASA
#
# SPDX-License-Identifier: LicenseRef-Nordic-5-Clause
#

cmake_minimum_required(VERSION 3.20.0)

find_package(Zephyr HINTS $ENV{ZEPHYR_BASE})

project(matter-weather-station)

# NORDIC SDK APP START

# Include all source files that are located in the Matter common directory.
include(${ZEPHYR_NCS_MATTER_MODULE_DIR}/cmake/sample.cmake)

ncs_get_zap_parent_dir(ZAP_PARENT_DIR)

target_include_directories(app PRIVATE
  src
  ${ZAP_PARENT_DIR}
)

target_sources(app PRIVATE
  src/app_task.cpp
  src/main.cpp
  src/battery.cpp
)

target_sources_ifdef(CONFIG_MATTER_WEATHER_STATION_BUZZER app PRIVATE
  src/buzzer.cpp
)

ncs_configure_data_model()
# NORDIC SDK APP END
```

## Kconfig
```
#
# Copyright (c) 2021 Nordic Semiconductor
#
# SPDX-License-Identifier: LicenseRef-Nordic-5-Clause
#

mainmenu "Matter weather station application"

config MATTER_WEATHER_STATION_BUZZER
	bool "Identify buzzer (PWM)"
	depends on BOARD_THINGY53
	default y
	help
	  When enabled the identify command will use a buzzer, in other cases, it will use an LED.

config MATTER_WEATHER_STATION_BATTERY
	bool "Battery measurement and charge control"
	depends on BOARD_THINGY53
	default y
	help
	  When enabled, battery voltage will be monitored.
	  Otherwise the Power Source cluster will expose mock data.

config AVERAGE_CURRENT_CONSUMPTION
	int "Average device current consumption in microamperes"
	default 0
	help
	  The predicted average current consumption of the Matter weather station
	  device, used to estimate the remaining battery time.

# Application configuration used for Thread networking
if OPENTHREAD

choice OPENTHREAD_NORDIC_LIBRARY_CONFIGURATION
	default OPENTHREAD_NORDIC_LIBRARY_MTD
endchoice

choice OPENTHREAD_DEVICE_TYPE
	default OPENTHREAD_MTD
endchoice

config IEEE802154_NRF5_RX_STACK_SIZE
	default 8192

config CHIP_ENABLE_ICD_SUPPORT
	default y

choice OPENTHREAD_IMPLEMENTATION
	default OPENTHREAD_SOURCES
endchoice

endif # OPENTHREAD

source "$(ZEPHYR_CONNECTEDHOMEIP_MODULE_DIR)/config/nrfconnect/chip-module/Kconfig.features"
source "$(ZEPHYR_CONNECTEDHOMEIP_MODULE_DIR)/config/nrfconnect/chip-module/Kconfig.defaults"
source "Kconfig.zephyr"
```

## Kconfig.sysbuild
```
#
# Copyright (c) 2023 Nordic Semiconductor ASA
#
# SPDX-License-Identifier: LicenseRef-Nordic-5-Clause
#

if BOARD_THINGY53
#### Radio core
config NRF_DEFAULT_IPC_RADIO
	default y

# Enable IEEE802.15.4 serialization to network core
# This config automatically pulls in the `overlay-802154.conf` in the ipc_radio image
config NETCORE_IPC_RADIO_IEEE802154
	default y if !WIFI_NRF70

# Enable Bluetooth serialization to network core
# This config automatically pulls in the `overlay-bt_hci_ipc.conf` in the ipc_radio image
config NETCORE_IPC_RADIO_BT_HCI_IPC
	default y

config SECURE_BOOT_NETCORE
	default y

config NETCORE_APP_UPDATE
	default y

config DFU_MULTI_IMAGE_PACKAGE_NET
	default y

endif

#### DFU multi-image support
config DFU_MULTI_IMAGE_PACKAGE_BUILD
	default y if !BOARD_NATIVE_SIM

config DFU_MULTI_IMAGE_PACKAGE_APP
	default y if !BOARD_NATIVE_SIM

# Internal flash only for nRF54L15 tag with compression
if BOARD_NRF54L15TAG

config MCUBOOT_COMPRESSED_IMAGE_SUPPORT
	default y

endif

choice BOOTLOADER
	default BOOTLOADER_MCUBOOT if !BOARD_NATIVE_SIM
endchoice

#### Bootloader
choice MCUBOOT_MODE
	default MCUBOOT_MODE_OVERWRITE_ONLY
endchoice

choice BOOT_SIGNATURE_TYPE
	default BOOT_SIGNATURE_TYPE_RSA
endchoice


source "share/sysbuild/Kconfig"
```

## sample.yaml
```
sample:
  name: Matter Weather Station
  description: Matter Weather Station application
common:
  tags:
    - sysbuild
    - ci_applications_matter
tests:
  # This configuration is used for performing DFU over BLE between different NCS
  # applications on Thingy53.
  applications.matter_weather_station.debug.no_fd:
    sysbuild: true
    build_only: true
    platform_allow:
      - thingy53/nrf5340/cpuapp
      - nrf54l15tag/nrf54l15/cpuapp
    platform_exclude: thingy53/nrf5340/cpuapp/ns
    integration_platforms:
      - thingy53/nrf5340/cpuapp
      - nrf54l15tag/nrf54l15/cpuapp
  applications.matter_weather_station.debug:
    sysbuild: true
    build_only: true
    extra_args:
      - OVERLAY_CONFIG=overlay-factory_data.conf
      - FILE_SUFFIX=factory_data
    platform_allow:
      - thingy53/nrf5340/cpuapp
      - nrf54l15tag/nrf54l15/cpuapp
    platform_exclude: thingy53/nrf5340/cpuapp/ns
    integration_platforms:
      - thingy53/nrf5340/cpuapp
      - nrf54l15tag/nrf54l15/cpuapp
  applications.matter_weather_station.release:
    sysbuild: true
    build_only: true
    extra_args:
      - OVERLAY_CONFIG=overlay-factory_data.conf
      - EXTRA_CONF_FILE=prj_release.conf
      - FILE_SUFFIX=factory_data
    platform_allow:
      - thingy53/nrf5340/cpuapp
      - nrf54l15tag/nrf54l15/cpuapp
    platform_exclude: thingy53/nrf5340/cpuapp/ns
    integration_platforms:
      - thingy53/nrf5340/cpuapp
      - nrf54l15tag/nrf54l15/cpuapp

  sample.matter.weather_station.native_sim:
    sysbuild: true
    build_only: true
    integration_platforms:
      - native_sim/native/64
    platform_allow:
      - native_sim/native/64
    extra_args:
      - SNIPPET=native-sim
```

## sysbuild.conf
```
#
# Copyright (c) 2024 Nordic Semiconductor
#
# SPDX-License-Identifier: LicenseRef-Nordic-5-Clause
#

SB_CONFIG_MERGED_HEX_FILES=y
```

## prj.conf
```kconfig
#
# Copyright (c) 2021 Nordic Semiconductor ASA
#
# SPDX-License-Identifier: LicenseRef-Nordic-5-Clause
#

# This sample uses Kconfig.defaults to set options common for all
# samples. This file contains only options common to all boards.
# Board-specific options are in boards/<board>.conf.

# Enable CHIP
CONFIG_CHIP=y
CONFIG_CHIP_PROJECT_CONFIG="src/chip_project_config.h"
CONFIG_CHIP_DEVICE_PRODUCT_NAME="Matter Weather Station"

# Configure ZAP file name
CONFIG_MATTER_ZAP_FILE_PATH="${APPLICATION_CONFIG_DIR}/src/default_zap/weather-station.zap"

# 32781 == 0x800D (matter example of Temperature measurement device as NCS Weather Station)
CONFIG_CHIP_DEVICE_PRODUCT_ID=32781
CONFIG_STD_CPP17=y

# Enable Matter pairing automatically on application start.
CONFIG_CHIP_ENABLE_PAIRING_AUTOSTART=y

# Enable Matter extended announcement and increase duration to 1 hour.
CONFIG_CHIP_BLE_EXT_ADVERTISING=y
CONFIG_CHIP_BLE_ADVERTISING_DURATION=60

# Enable Bluetooth Low Energy
CONFIG_BT_DEVICE_NAME="MatterWeather"

# Add support for LEDs, buttons and buzzer
CONFIG_DK_LIBRARY=y

# Sensors (BME680; board overlay enables correct I2C node)
CONFIG_I2C=y
CONFIG_SENSOR=y
CONFIG_BME680=y

# Suspend devices when the CPU goes into sleep
CONFIG_PM_DEVICE=y

# Other settings
CONFIG_IEEE802154_NRF5_RX_STACK_SIZE=8192
CONFIG_THREAD_NAME=y
CONFIG_MPU_STACK_GUARD=y
CONFIG_CHIP_LIB_SHELL=y
CONFIG_MATTER_TEST_SHELL=y

# Enable DFU over Bluetooth LE SMP
CONFIG_CHIP_DFU_OVER_BT_SMP=y

# Increase system workqueue size, as SMP is processed within it
CONFIG_SYSTEM_WORKQUEUE_STACK_SIZE=4096

# 0x0302 (Temp. sensor)
CONFIG_CHIP_DEVICE_TYPE=770
CONFIG_BT_RX_STACK_SIZE=1500

# Logging (backend chosen per-board)
CONFIG_LOG=y
CONFIG_MATTER_LOG_LEVEL_DBG=y
CONFIG_SHELL=y

# Disable Factory Data feature
CONFIG_CHIP_FACTORY_DATA_NONE=y
```

## overlay-factory_data.conf
```kconfig
#
# Copyright (c) 2022 Nordic Semiconductor ASA
#
# SPDX-License-Identifier: LicenseRef-Nordic-5-Clause
#

# Use this overlay to re-generate new PAI and DAC certificates.
# Be sure that chip-cert executable is added to your system PATH.

# Enable building the new factory data
CONFIG_CHIP_FACTORY_DATA=y
CONFIG_CHIP_FACTORY_DATA_BUILD=y
CONFIG_CHIP_FACTORY_DATA_NRFCONNECT_BACKEND=y
CONFIG_CHIP_FACTORY_DATA_USE_DEFAULT_CERTS=y
CONFIG_CHIP_FACTORY_DATA_MERGE_WITH_FIRMWARE=y
CONFIG_CHIP_DEVICE_GENERATE_ROTATING_DEVICE_UID=n
CONFIG_CHIP_FACTORY_DATA_GENERATE_ONBOARDING_CODES=y

# Set up the Factory Data
CONFIG_CHIP_DEVICE_SERIAL_NUMBER="3"
CONFIG_CHIP_DEVICE_VENDOR_ID=65521
CONFIG_CHIP_DEVICE_VENDOR_NAME="Nordic Semiconductor ASA"
CONFIG_CHIP_DEVICE_PRODUCT_ID=32781
CONFIG_CHIP_DEVICE_PRODUCT_NAME="Matter Weather Station"
CONFIG_CHIP_DEVICE_MANUFACTURING_DATE="2022-07-12"
CONFIG_CHIP_DEVICE_HARDWARE_VERSION=1
CONFIG_CHIP_DEVICE_HARDWARE_VERSION_STRING="SVE"
CONFIG_CHIP_DEVICE_DISCRIMINATOR=0x635
CONFIG_CHIP_DEVICE_SPAKE2_PASSCODE=65286841
CONFIG_CHIP_DEVICE_SPAKE2_IT=1000
CONFIG_CHIP_DEVICE_SPAKE2_TEST_VERIFIER="3kX890KClffU+BvLXQm68RDvXWlyuPofi8DEFkv74mQEnC+g02oLJTkItSDLBUvuYX87D1C7SnHZ7PuWvDziO57cHjPgUlkEhlRj+bvWKmE/FEwKuffl+VB7Dlx9HurJwQ=="
CONFIG_CHIP_DEVICE_ROTATING_DEVICE_UID="1566d6032a898e53f7d58133a19ac9d2"
CONFIG_CHIP_DEVICE_ENABLE_KEY="449eb9544ee3eef8d9fb7accb514fada"
```

## prj_release.conf
```kconfig
#
# Copyright (c) 2021 Nordic Semiconductor ASA
#
# SPDX-License-Identifier: LicenseRef-Nordic-5-Clause
#

# This sample uses Kconfig.defaults to set options common for all
# samples. This file should contain only options specific for this sample
# or overrides of default values.

# Enable CHIP
CONFIG_CHIP=y
CONFIG_CHIP_PROJECT_CONFIG="src/chip_project_config.h"
CONFIG_CHIP_DEVICE_PRODUCT_NAME="Matter Weather Station"

# Configure ZAP file name
CONFIG_MATTER_ZAP_FILE_PATH="${APPLICATION_CONFIG_DIR}/src/default_zap/weather-station.zap"

# 32781 == 0x800D (matter example of Temperature measurement device as NCS Weather Station)
CONFIG_CHIP_DEVICE_PRODUCT_ID=32781
CONFIG_STD_CPP17=y

# Enable Matter pairing automatically on application start.
CONFIG_CHIP_ENABLE_PAIRING_AUTOSTART=y

# Enable Matter extended announcement and increase duration to 1 hour.
CONFIG_CHIP_BLE_EXT_ADVERTISING=y
CONFIG_CHIP_BLE_ADVERTISING_DURATION=60

# Enable Bluetooth Low Energy
CONFIG_BT_DEVICE_NAME="MatterWeather"

# Add support for LEDs, buttons and buzzer
CONFIG_DK_LIBRARY=y

# Sensors (BME680; board overlay enables correct I2C node)
CONFIG_I2C=y
CONFIG_SENSOR=y
CONFIG_BME680=y

# Suspend devices when the CPU goes into sleep
CONFIG_PM_DEVICE=y

# Other settings
CONFIG_THREAD_NAME=n
CONFIG_MPU_STACK_GUARD=n
CONFIG_CHIP_LIB_SHELL=n
CONFIG_MATTER_TEST_SHELL=n

# Enable DFU over Bluetooth LE SMP
CONFIG_CHIP_DFU_OVER_BT_SMP=y

# Increase system workqueue size, as SMP is processed within it
CONFIG_SYSTEM_WORKQUEUE_STACK_SIZE=4096

# 0x0302 (Temp. sensor)
CONFIG_CHIP_DEVICE_TYPE=770
CONFIG_BT_RX_STACK_SIZE=1500

# Disable all debug features
CONFIG_SHELL=n
CONFIG_OPENTHREAD_SHELL=n
CONFIG_CONSOLE=n
CONFIG_UART_CONSOLE=n
CONFIG_SERIAL=n
CONFIG_LOG=n
CONFIG_LOG_MODE_MINIMAL=n
CONFIG_THREAD_NAME=n
CONFIG_ASSERT_VERBOSE=n
CONFIG_ASSERT_NO_FILE_INFO=y

# Disable USB CDC ACM
CONFIG_BOARD_SERIAL_BACKEND_CDC_ACM=n

# Enable Watchdog
CONFIG_MATTER_WATCHDOG=y

# Enable LTO
CONFIG_LTO=y
CONFIG_ISR_TABLES_LOCAL_DECLARATION=y

# Disable Factory Data feature
CONFIG_CHIP_FACTORY_DATA_NONE=y
```

## boards/nrf54l15tag_nrf54l15_cpuapp.conf
```kconfig
#
# Copyright (c) 2026 Nordic Semiconductor ASA
#
# SPDX-License-Identifier: LicenseRef-Nordic-5-Clause
#

# Console and logs over RTT (tag has no UART)
CONFIG_USE_SEGGER_RTT=y
CONFIG_CONSOLE=y
CONFIG_RTT_CONSOLE=y
CONFIG_UART_CONSOLE=n
CONFIG_LOG_BACKEND_RTT=y
CONFIG_LOG_MODE_MINIMAL=y
CONFIG_SEGGER_RTT_BUFFER_SIZE_UP=4096

# No NFC hardware (NFCT pins used as GPIO)
CONFIG_CHIP_NFC_ONBOARDING_PAYLOAD=n

# No diagnostic log retention on this board
CONFIG_MATTER_DIAGNOSTIC_LOGS=n

# Watchdog
CONFIG_MATTER_WATCHDOG=y

# Size optimization
CONFIG_LTO=y
CONFIG_ISR_TABLES_LOCAL_DECLARATION=y

# Mock value
CONFIG_AVERAGE_CURRENT_CONSUMPTION=1000
```

## boards/thingy53_nrf5340_cpuapp.conf
```kconfig
#
# Copyright (c) 2026 Nordic Semiconductor ASA
#
# SPDX-License-Identifier: LicenseRef-Nordic-5-Clause
#

# Buzzer (PWM)
CONFIG_PWM=y

# Battery measurement (ADC)
CONFIG_ADC=y

# Power profiling
CONFIG_AVERAGE_CURRENT_CONSUMPTION=10000

# UART console and shell
CONFIG_SHELL_LOG_BACKEND=y
CONFIG_SHELL_BACKEND_SERIAL_INIT_PRIORITY=51
CONFIG_LOG_MODE_DEFERRED=y
CONFIG_LOG_PROCESS_THREAD_STACK_SIZE=1024
CONFIG_LOG_BUFFER_SIZE=8192
CONFIG_LOG_FUNC_NAME_PREFIX_DBG=n

# USB CDC ACM
CONFIG_USB_DEVICE_STACK_NEXT=y
CONFIG_CDC_ACM_SERIAL_MANUFACTURER_STRING="Nordic Semiconductor ASA"
CONFIG_CDC_ACM_SERIAL_PRODUCT_STRING="Thingy:53 Matter Weather"
CONFIG_CDC_ACM_SERIAL_VID=0x1915
CONFIG_CDC_ACM_SERIAL_PID=0x530D
CONFIG_UART_LINE_CTRL=y

# Diagnostic logs
CONFIG_MATTER_DIAGNOSTIC_LOGS=y
CONFIG_MATTER_DIAGNOSTIC_LOGS_CRASH_LOGS=y
CONFIG_MATTER_DIAGNOSTIC_LOGS_REMOVE_CRASH_AFTER_READ=y
CONFIG_MATTER_DIAGNOSTIC_LOGS_END_USER_LOGS=y
CONFIG_MATTER_DIAGNOSTIC_LOGS_NETWORK_LOGS=y
CONFIG_MATTER_DIAGNOSTIC_LOGS_TEST=y

# NVS settings: storage partition is 48 KiB (0xc000); 12 × 4 KiB sectors.
CONFIG_SETTINGS_NVS_SECTOR_COUNT=12
```

## src/app_task.cpp
```c
/*
 * Copyright (c) 2021 Nordic Semiconductor ASA
 *
 * SPDX-License-Identifier: LicenseRef-Nordic-5-Clause
 */

#include "app_task.h"

#include "battery.h"
#ifdef CONFIG_MATTER_WEATHER_STATION_BUZZER
#include "buzzer.h"
#endif

#include "app/matter_init.h"
#include "app/task_executor.h"
#include "board/board.h"
#include "board/led_widget.h"
#include "clusters/identify.h"

#ifdef CONFIG_CHIP_DFU_OVER_BT_SMP
#include "dfu/smp/dfu_over_smp.h"
#endif

#include <app-common/zap-generated/attributes/Accessors.h>
#include <app-common/zap-generated/cluster-objects.h>
#include <app/DefaultTimerDelegate.h>
#include <app/cluster-building-blocks/QuieterReporting.h>
#include <app/server/Server.h>
#include <setup_payload/OnboardingCodesUtil.h>

#include <zephyr/drivers/sensor.h>
#include <zephyr/logging/log.h>

#ifdef CONFIG_MATTER_WEATHER_STATION_BUZZER
#define IDENTIFY_TYPE Clusters::Identify::IdentifyTypeEnum::kAudibleBeep
#else
#define IDENTIFY_TYPE Clusters::Identify::IdentifyTypeEnum::kLightOutput
#endif

LOG_MODULE_DECLARE(app, CONFIG_CHIP_APP_LOG_LEVEL);

using namespace ::chip;
using namespace ::chip::DeviceLayer;
using namespace ::chip::app;

namespace
{
enum class FunctionTimerMode { kDisabled, kFactoryResetTrigger, kFactoryResetComplete };
enum class LedState { kAlive, kAdvertisingBle, kConnectedBle, kProvisioned };

#if CONFIG_AVERAGE_CURRENT_CONSUMPTION <= 0
#error Invalid CONFIG_AVERAGE_CURRENT_CONSUMPTION value set
#endif

constexpr size_t kMeasurementsIntervalMs = 3000;
constexpr uint8_t kTemperatureMeasurementEndpointId = 1;
constexpr int16_t kTemperatureMeasurementAttributeMaxValue = 0x7fff;
constexpr int16_t kTemperatureMeasurementAttributeMinValue = 0x954d;
constexpr int16_t kTemperatureMeasurementAttributeInvalidValue = 0x8000;
constexpr uint8_t kHumidityMeasurementEndpointId = 2;
constexpr uint16_t kHumidityMeasurementAttributeMaxValue = 0x2710;
constexpr uint16_t kHumidityMeasurementAttributeMinValue = 0;
constexpr uint16_t kHumidityMeasurementAttributeInvalidValue = 0xffff;
constexpr uint8_t kPressureMeasurementEndpointId = 3;
constexpr int16_t kPressureMeasurementAttributeMaxValue = 0x7fff;
constexpr int16_t kPressureMeasurementAttributeMinValue = 0x8001;
constexpr int16_t kPressureMeasurementAttributeInvalidValue = 0x8000;
constexpr uint8_t kPowerSourceEndpointId = 0;
constexpr int16_t kMinimalOperatingVoltageMv = 3200;
constexpr int16_t kMaximalOperatingVoltageMv = 4050;
constexpr int16_t kWarningThresholdVoltageMv = 3450;
constexpr int16_t kCriticalThresholdVoltageMv = 3250;
constexpr uint8_t kMinBatteryPercentage = 0;
/* Value is expressed in half percent units ranging from 0 to 200. */
constexpr uint8_t kMaxBatteryPercentage = 200;
/* Battery capacity in uAh */
constexpr uint32_t kBatteryCapacityUaH = 1350000;
/* Average device current consumption in uA */
constexpr uint32_t kDeviceAverageCurrentConsumptionUa = CONFIG_AVERAGE_CURRENT_CONSUMPTION;
/* Fully charged battery operation time in seconds */
constexpr uint32_t kFullBatteryOperationTime = kBatteryCapacityUaH / kDeviceAverageCurrentConsumptionUa * 3600;
/* It is recommended to toggle the signalled state with 0.5 s interval. */
constexpr size_t kIdentifyTimerIntervalMs = 500;

k_timer sMeasurementsTimer;
k_timer sIdentifyTimer;

const device *sBme688SensorDev = DEVICE_DT_GET_ONE(bosch_bme680);

class IdentifyDelegateImplWeatherStation : public chip::app::Clusters::IdentifyDelegate {
public:
	void OnIdentifyStart(chip::app::Clusters::IdentifyCluster &cluster) override
	{
		Nrf::PostTask([] {
			Nrf::GetBoard().GetLED(Nrf::DeviceLeds::LED2).Blink(Nrf::LedConsts::kIdentifyBlinkRate_ms);
#if CONFIG_MATTER_WEATHER_STATION_BUZZER
			k_timer_start(&sIdentifyTimer, K_MSEC(kIdentifyTimerIntervalMs),
				      K_MSEC(kIdentifyTimerIntervalMs));
			BuzzerSetState(true);
#endif
		});
	}

	void OnIdentifyStop(chip::app::Clusters::IdentifyCluster &cluster) override
	{
		Nrf::PostTask([] {
			Nrf::GetBoard().GetLED(Nrf::DeviceLeds::LED2).Set(false);
#if CONFIG_MATTER_WEATHER_STATION_BUZZER
			k_timer_stop(&sIdentifyTimer);
			BuzzerSetState(false);
#endif
		});
	}

	/**
	 * Trigger Effect command is not supported by default by this device
	 * It can be enabled by returning true in the IsTriggerEffectEnabled function
	 * When enabled handle the command in the function below
	 */
	void OnTriggerEffect(chip::app::Clusters::IdentifyCluster &cluster) override
	{
#if CONFIG_MATTER_WEATHER_STATION_BUZZER
		Nrf::PostTask([] { BuzzerToggleState(); });
#endif
	}

	bool IsTriggerEffectEnabled() const override { return false; }
};

IdentifyDelegateImplWeatherStation sIdentifyDelegateImplWeatherStation;
DefaultTimerDelegate sTimerDelegate;

Nrf::Matter::IdentifyCluster sIdentifyTemperature(kTemperatureMeasurementEndpointId,
						  sIdentifyDelegateImplWeatherStation, sTimerDelegate, IDENTIFY_TYPE);
Nrf::Matter::IdentifyCluster sIdentifyHumidity(kHumidityMeasurementEndpointId, sIdentifyDelegateImplWeatherStation,
					       sTimerDelegate, IDENTIFY_TYPE);
Nrf::Matter::IdentifyCluster sIdentifyPressure(kPressureMeasurementEndpointId, sIdentifyDelegateImplWeatherStation,
					       sTimerDelegate, IDENTIFY_TYPE);

} /* namespace */

void AppTask::MeasurementsTimerHandler()
{
	Instance().UpdateClustersState();
}

void AppTask::IdentifyTimerHandler()
{
#if CONFIG_MATTER_WEATHER_STATION_BUZZER
	BuzzerToggleState();
#endif
}

void AppTask::UpdateTemperatureClusterState()
{
	sensor_value temperature;
	Protocols::InteractionModel::Status status;
	int result = sensor_channel_get(sBme688SensorDev, SENSOR_CHAN_AMBIENT_TEMP, &temperature);
	if (result == 0) {
		/* Defined by cluster temperature measured value = 100 x temperature in degC with resolution of
		 * 0.01 degC. val1 is an integer part of the value and val2 is fractional part in one-millionth
		 * parts. To achieve resolution of 0.01 degC val2 needs to be divided by 10000. */
		int16_t newValue = static_cast<int16_t>(temperature.val1 * 100 + temperature.val2 / 10000);

		if (newValue > kTemperatureMeasurementAttributeMaxValue ||
		    newValue < kTemperatureMeasurementAttributeMinValue) {
			/* Read value exceeds permitted limits, so assign invalid value code to it. */
			newValue = kTemperatureMeasurementAttributeInvalidValue;
		}
		LOG_DBG("New temperature measurement %d.%d *C", temperature.val1, temperature.val2);

		status = Clusters::TemperatureMeasurement::Attributes::MeasuredValue::Set(
			kTemperatureMeasurementEndpointId, newValue);
		if (status != Protocols::InteractionModel::Status::Success) {
			LOG_ERR("Updating temperature measurement %x", to_underlying(status));
		}
	} else {
		LOG_ERR("Getting temperature measurement data from BME688 failed with: %d", result);
	}
}

void AppTask::UpdatePressureClusterState()
{
	sensor_value pressure;
	Protocols::InteractionModel::Status status;
	int result = sensor_channel_get(sBme688SensorDev, SENSOR_CHAN_PRESS, &pressure);
	if (result == 0) {
		/* Defined by cluster pressure measured value = 10 x pressure in kPa with resolution of 0.1 kPa.
		 * val1 is an integer part of the value and val2 is fractional part in one-millionth parts.
		 * To achieve resolution of 0.1 kPa val2 needs to be divided by 100000. */
		int16_t newValue = static_cast<int16_t>(pressure.val1 * 10 + pressure.val2 / 100000);

		if (newValue > kPressureMeasurementAttributeMaxValue ||
		    newValue < kPressureMeasurementAttributeMinValue) {
			/* Read value exceeds permitted limits, so assign invalid value code to it. */
			newValue = kPressureMeasurementAttributeInvalidValue;
		}
		LOG_DBG("New pressure measurement %d.%d kPa", pressure.val1, pressure.val2);

		status = Clusters::PressureMeasurement::Attributes::MeasuredValue::Set(kPressureMeasurementEndpointId,
										       newValue);
		if (status != Protocols::InteractionModel::Status::Success) {
			LOG_ERR("Updating pressure measurement %x", to_underlying(status));
		}
	} else {
		LOG_ERR("Getting pressure measurement data from BME688 failed with: %d", result);
	}
}

void AppTask::UpdateRelativeHumidityClusterState()
{
	sensor_value humidity;
	Protocols::InteractionModel::Status status;
	int result = sensor_channel_get(sBme688SensorDev, SENSOR_CHAN_HUMIDITY, &humidity);
	if (result == 0) {
		/* Defined by cluster humidity measured value = 100 x humidity in %RH with resolution of 0.01 %.
		 * val1 is an integer part of the value and val2 is fractional part in one-millionth parts.
		 * To achieve resolution of 0.01 % val2 needs to be divided by 10000. */
		uint16_t newValue = static_cast<int16_t>(humidity.val1 * 100 + humidity.val2 / 10000);

		if (newValue > kHumidityMeasurementAttributeMaxValue ||
		    newValue < kHumidityMeasurementAttributeMinValue) {
			/* Read value exceeds permitted limits, so assign invalid value code to it. */
			newValue = kHumidityMeasurementAttributeInvalidValue;
		}
		LOG_DBG("New humidity measurement %d.%d %%", humidity.val1, humidity.val2);

		status = Clusters::RelativeHumidityMeasurement::Attributes::MeasuredValue::Set(
			kHumidityMeasurementEndpointId, newValue);
		if (status != Protocols::InteractionModel::Status::Success) {
			LOG_ERR("Updating relative humidity measurement %x", to_underlying(status));
		}
	} else {
		LOG_ERR("Getting humidity measurement data from BME688 failed with: %d", result);
	}
}

void AppTask::UpdatePowerSourceClusterState()
{
	Protocols::InteractionModel::Status status;
	int32_t voltage = BatteryMeasurementReadVoltageMv();
	/* Value is expressed in half percent units ranging from 0 to 200. */
	uint8_t batteryPercentage;
	uint32_t batteryTimeRemaining;
	Clusters::PowerSource::PowerSourceStatusEnum batteryStatus;
	Clusters::PowerSource::BatChargeLevelEnum batteryChargeLevel;
	bool batteryPresent;
	Clusters::PowerSource::BatChargeStateEnum batteryCharged;

	if (voltage < 0) {
		voltage = 0;
		batteryPercentage = 0;
		batteryStatus = Clusters::PowerSource::PowerSourceStatusEnum::kUnavailable;
		batteryPresent = false;

		LOG_ERR("Battery level measurement failed %d", voltage);
	} else {
		batteryStatus = Clusters::PowerSource::PowerSourceStatusEnum::kActive;
		batteryPresent = true;
	}

	if (voltage <= kMinimalOperatingVoltageMv) {
		batteryPercentage = kMinBatteryPercentage;
	} else if (voltage >= kMaximalOperatingVoltageMv) {
		batteryPercentage = kMaxBatteryPercentage;
	} else {
		batteryPercentage = kMaxBatteryPercentage * (voltage - kMinimalOperatingVoltageMv) /
				    (kMaximalOperatingVoltageMv - kMinimalOperatingVoltageMv);
	}

	batteryTimeRemaining = kFullBatteryOperationTime * batteryPercentage / kMaxBatteryPercentage;

	if (voltage < kCriticalThresholdVoltageMv) {
		batteryChargeLevel = Clusters::PowerSource::BatChargeLevelEnum::kCritical;
	} else if (voltage < kWarningThresholdVoltageMv) {
		batteryChargeLevel = Clusters::PowerSource::BatChargeLevelEnum::kWarning;
	} else {
		batteryChargeLevel = Clusters::PowerSource::BatChargeLevelEnum::kOk;
	}

	if (BatteryCharged()) {
		batteryCharged = Clusters::PowerSource::BatChargeStateEnum::kIsCharging;
	} else {
		batteryCharged = Clusters::PowerSource::BatChargeStateEnum::kIsNotCharging;
	}

	status = Clusters::PowerSource::Attributes::BatVoltage::Set(kPowerSourceEndpointId, voltage);
	if (status != Protocols::InteractionModel::Status::Success) {
		LOG_ERR("Updating battery voltage failed %x", to_underlying(status));
	}

	/* Battery attributes have a Q quality, it shouldn't be reported every time a new measurement comes (3s).
	 * update it only once every Xs(chose 10) or less frequent.
	 */
	static QuieterReportingAttribute<uint8_t> batPercentRemainingQuiet{ DataModel::NullNullable };
	static QuieterReportingAttribute<uint32_t> batTimeRemainingQuiet{ DataModel::NullNullable };
	constexpr System::Clock::Milliseconds64 kBatteryReportInterval{ 10000 };
	const System::Clock::Timestamp now = System::SystemClock().GetMonotonicTimestamp();

	const AttributeDirtyState batPercentDirty = batPercentRemainingQuiet.SetValue(
		DataModel::MakeNullable(batteryPercentage), now,
		QuieterReportingAttribute<uint8_t>::GetPredicateForSufficientTimeSinceLastDirty(
			kBatteryReportInterval));
	status = Clusters::PowerSource::Attributes::BatPercentRemaining::Set(
		kPowerSourceEndpointId, batteryPercentage,
		batPercentDirty == AttributeDirtyState::kMustReport ? MarkAttributeDirty::kYes :
								      MarkAttributeDirty::kNo);
	if (status != Protocols::InteractionModel::Status::Success) {
		LOG_ERR("Updating battery percentage failed %x", to_underlying(status));
	}

	const AttributeDirtyState batTimeDirty = batTimeRemainingQuiet.SetValue(
		DataModel::MakeNullable(batteryTimeRemaining), now,
		QuieterReportingAttribute<uint32_t>::GetPredicateForSufficientTimeSinceLastDirty(
			kBatteryReportInterval));
	status = Clusters::PowerSource::Attributes::BatTimeRemaining::Set(
		kPowerSourceEndpointId, batteryTimeRemaining,
		batTimeDirty == AttributeDirtyState::kMustReport ? MarkAttributeDirty::kYes : MarkAttributeDirty::kNo);
	if (status != Protocols::InteractionModel::Status::Success) {
		LOG_ERR("Updating battery time remaining failed %x", to_underlying(status));
	}

	status = Clusters::PowerSource::Attributes::BatChargeLevel::Set(kPowerSourceEndpointId, batteryChargeLevel);
	if (status != Protocols::InteractionModel::Status::Success) {
		LOG_ERR("Updating battery charge level failed %x", to_underlying(status));
	}

	status = Clusters::PowerSource::Attributes::Status::Set(kPowerSourceEndpointId, batteryStatus);
	if (status != Protocols::InteractionModel::Status::Success) {
		LOG_ERR("Updating battery status failed %x", to_underlying(status));
	}

	status = Clusters::PowerSource::Attributes::BatPresent::Set(kPowerSourceEndpointId, batteryPresent);
	if (status != Protocols::InteractionModel::Status::Success) {
		LOG_ERR("Updating battery present failed %x", to_underlying(status));
	}

	status = Clusters::PowerSource::Attributes::BatChargeState::Set(kPowerSourceEndpointId, batteryCharged);
	if (status != Protocols::InteractionModel::Status::Success) {
		LOG_ERR("Updating battery charge failed %x", to_underlying(status));
	}
}

void AppTask::UpdateClustersState()
{
	const int result = sensor_sample_fetch(sBme688SensorDev);

	if (result == 0) {
		UpdateTemperatureClusterState();
		UpdatePressureClusterState();
		UpdateRelativeHumidityClusterState();
	} else {
		LOG_ERR("Fetching data from BME688 sensor failed with: %d", result);
	}

	UpdatePowerSourceClusterState();
}

void AppTask::UpdateLedState()
{
	if (!Instance().mGreenLED || !Instance().mBlueLED || !Instance().mRedLED) {
		return;
	}

	Instance().mGreenLED->Set(false);
	Instance().mBlueLED->Set(false);
	Instance().mRedLED->Set(false);

	switch (Nrf::GetBoard().GetDeviceState()) {
	case Nrf::DeviceState::DeviceAdvertisingBLE:
		Instance().mBlueLED->Blink(Nrf::LedConsts::StatusLed::Disconnected::kOn_ms,
					   Nrf::LedConsts::StatusLed::Disconnected::kOff_ms);
		break;
	case Nrf::DeviceState::DeviceDisconnected:
		Instance().mGreenLED->Blink(Nrf::LedConsts::StatusLed::Disconnected::kOn_ms,
					    Nrf::LedConsts::StatusLed::Disconnected::kOff_ms);
		break;
	case Nrf::DeviceState::DeviceConnectedBLE:
		Instance().mBlueLED->Blink(Nrf::LedConsts::StatusLed::BleConnected::kOn_ms,
					   Nrf::LedConsts::StatusLed::BleConnected::kOff_ms);
		break;
	case Nrf::DeviceState::DeviceProvisioned:
		Instance().mRedLED->Blink(Nrf::LedConsts::StatusLed::Disconnected::kOn_ms,
					  Nrf::LedConsts::StatusLed::Disconnected::kOff_ms);
		Instance().mBlueLED->Blink(Nrf::LedConsts::StatusLed::Disconnected::kOn_ms,
					   Nrf::LedConsts::StatusLed::Disconnected::kOff_ms);
		break;
	default:
		break;
	}
}

CHIP_ERROR AppTask::Init()
{
	/* Initialize Matter stack */
#ifdef CONFIG_CHIP_DFU_OVER_BT_SMP
	ReturnErrorOnFailure(
		Nrf::Matter::PrepareServer(Nrf::Matter::InitData{ .mPostServerInitClbk = []() -> CHIP_ERROR {
			Nrf::GetDFUOverSMP().StartServer();
			return CHIP_NO_ERROR;
		} }));
#else
	ReturnErrorOnFailure(Nrf::Matter::PrepareServer());
#endif

	/* Set references for RGB LED */
	mRedLED = &Nrf::GetBoard().GetLED(Nrf::DeviceLeds::LED1);
	mGreenLED = &Nrf::GetBoard().GetLED(Nrf::DeviceLeds::LED2);
	mBlueLED = &Nrf::GetBoard().GetLED(Nrf::DeviceLeds::LED3);

	if (!Nrf::GetBoard().Init(nullptr, UpdateLedState)) {
		LOG_ERR("User interface initialization failed.");
		return CHIP_ERROR_INCORRECT_STATE;
	}

	/* Register Matter event handler that controls the connectivity status LED based on the captured Matter network
	 * state. */
	ReturnErrorOnFailure(Nrf::Matter::RegisterEventHandler(Nrf::Board::DefaultMatterEventHandler, 0));

	if (!device_is_ready(sBme688SensorDev)) {
		LOG_ERR("BME688 sensor device not ready");
		return chip::System::MapErrorZephyr(-ENODEV);
	}

#if CONFIG_MATTER_WEATHER_STATION_BATTERY
	int ret_battery = BatteryMeasurementInit();
	if (ret_battery) {
		LOG_ERR("Battery measurement init failed");
		return chip::System::MapErrorZephyr(ret_battery);
	}

	ret_battery = BatteryMeasurementEnable();
	if (ret_battery) {
		LOG_ERR("Enabling battery measurement failed");
		return chip::System::MapErrorZephyr(ret_battery);
	}

	ret_battery = BatteryChargeControlInit();
	if (ret_battery) {
		LOG_ERR("Battery charge control init failed");
		return chip::System::MapErrorZephyr(ret_battery);
	}
#endif

#if CONFIG_MATTER_WEATHER_STATION_BUZZER
	int ret_buzzer = BuzzerInit();
	if (ret_buzzer) {
		LOG_ERR("Buzzer init failed");
		return chip::System::MapErrorZephyr(ret_buzzer);
	}
#endif

	ReturnErrorOnFailure(sIdentifyTemperature.Init());
	ReturnErrorOnFailure(sIdentifyHumidity.Init());
	ReturnErrorOnFailure(sIdentifyPressure.Init());

	/* Initialize timers */
	k_timer_init(
		&sMeasurementsTimer, [](k_timer *) { Nrf::PostTask([] { MeasurementsTimerHandler(); }); }, nullptr);
	k_timer_init(&sIdentifyTimer, [](k_timer *) { Nrf::PostTask([] { IdentifyTimerHandler(); }); }, nullptr);
	k_timer_start(&sMeasurementsTimer, K_MSEC(kMeasurementsIntervalMs), K_MSEC(kMeasurementsIntervalMs));

	return Nrf::Matter::StartServer();
}

CHIP_ERROR AppTask::StartApp()
{
	ReturnErrorOnFailure(Init());

	while (true) {
		Nrf::DispatchNextTask();
	}

	return CHIP_NO_ERROR;
}
```

## src/chip_project_config.h
```c
/*
 * Copyright (c) 2021 Nordic Semiconductor ASA
 *
 * SPDX-License-Identifier: LicenseRef-Nordic-5-Clause
 */

/**
 *    @file
 *          Example project configuration file for CHIP.
 *
 *          This is a place to put application or project-specific overrides
 *          to the default configuration values for general CHIP features.
 *
 */

#pragma once

#include "../../../subsys/app/chip_project_config_native_sim.h"

#ifdef CONFIG_CHIP_FACTORY_DATA
/* Store Certification Declaration */
#define CHIP_DEVICE_CONFIG_CERTIFICATION_DECLARATION                                                                   \
	{ 0x30, 0x81, 0xe9, 0x06, 0x09, 0x2a, 0x86, 0x48, 0x86, 0xf7, 0x0d, 0x01, 0x07, 0x02, 0xa0, 0x81, 0xdb,        \
	  0x30, 0x81, 0xd8, 0x02, 0x01, 0x03, 0x31, 0x0d, 0x30, 0x0b, 0x06, 0x09, 0x60, 0x86, 0x48, 0x01, 0x65,        \
	  0x03, 0x04, 0x02, 0x01, 0x30, 0x45, 0x06, 0x09, 0x2a, 0x86, 0x48, 0x86, 0xf7, 0x0d, 0x01, 0x07, 0x01,        \
	  0xa0, 0x38, 0x04, 0x36, 0x15, 0x24, 0x00, 0x01, 0x25, 0x01, 0xf1, 0xff, 0x36, 0x02, 0x05, 0x0d, 0x80,        \
	  0x18, 0x25, 0x03, 0x02, 0x03, 0x2c, 0x04, 0x13, 0x5a, 0x49, 0x47, 0x32, 0x30, 0x31, 0x34, 0x32, 0x5a,        \
	  0x42, 0x33, 0x33, 0x30, 0x30, 0x30, 0x33, 0x2d, 0x32, 0x34, 0x24, 0x05, 0x00, 0x24, 0x06, 0x00, 0x25,        \
	  0x07, 0x94, 0x26, 0x24, 0x08, 0x00, 0x18, 0x31, 0x7d, 0x30, 0x7b, 0x02, 0x01, 0x03, 0x80, 0x14, 0x62,        \
	  0xfa, 0x82, 0x33, 0x59, 0xac, 0xfa, 0xa9, 0x96, 0x3e, 0x1c, 0xfa, 0x14, 0x0a, 0xdd, 0xf5, 0x04, 0xf3,        \
	  0x71, 0x60, 0x30, 0x0b, 0x06, 0x09, 0x60, 0x86, 0x48, 0x01, 0x65, 0x03, 0x04, 0x02, 0x01, 0x30, 0x0a,        \
	  0x06, 0x08, 0x2a, 0x86, 0x48, 0xce, 0x3d, 0x04, 0x03, 0x02, 0x04, 0x47, 0x30, 0x45, 0x02, 0x21, 0x00,        \
	  0xc8, 0xd5, 0xd8, 0xc6, 0x4e, 0x18, 0x3b, 0x6c, 0x69, 0x23, 0xb2, 0x70, 0xcf, 0xf2, 0x24, 0x2a, 0xfb,        \
	  0x08, 0x42, 0xec, 0x3b, 0x7b, 0x09, 0x14, 0x4d, 0xc1, 0x98, 0x2c, 0xf5, 0x4a, 0x17, 0x0c, 0x02, 0x20,        \
	  0x39, 0xa0, 0xf7, 0xb4, 0x86, 0x10, 0x32, 0x33, 0x01, 0xc2, 0xe4, 0x0f, 0xe0, 0x4b, 0x9c, 0x2d, 0x4d,        \
	  0x41, 0x13, 0xfd, 0xc3, 0x11, 0xe1, 0x00, 0x34, 0xa4, 0xe1, 0x7c, 0x09, 0x27, 0x45, 0x7b };
#endif
```
