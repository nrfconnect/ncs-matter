## west.yml
```yaml
# Copyright (c) 2026 Nordic Semiconductor ASA
# SPDX-License-Identifier: Apache-2.0

manifest:
  remotes:
    - name: ncs
      url-base: https://github.com/nrfconnect

  projects:
    - name: nrf
      remote: ncs
      repo-path: sdk-nrf
      revision: d09e64cd1e3f224440d640a1aff05dde514e9e3b
      import: true
    - name: matter
      remote: ncs
      path: modules/lib/matter
      repo-path: sdk-connectedhomeip
      revision: 9d0183af3cf8dcde9144ee4ae39fb34c6e9ef873
      submodules:
        - name: nlio
          path: third_party/nlio/repo
        - name: nlassert
          path: third_party/nlassert/repo
        - name: pigweed
          path: third_party/pigweed/repo
        - name: jsoncpp
          path: third_party/jsoncpp/repo
        - name: uriparser
          path: third_party/uriparser/repo
      userdata:
        ncs:
          upstream-url: https://github.com/project-chip/connectedhomeip
          upstream-sha: badaac1eae0df6902c1d009981c0e0d18845aeea
          compare-by-default: false

  self:
    path: ncs-matter
    west-commands: scripts/west/west-commands.yml
```
